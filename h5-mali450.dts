/dts-v1/;
/plugin/;
#include <dt-bindings/clock/sun8i-h3-ccu.h>
#include <dt-bindings/interrupt-controller/arm-gic.h>
#include <dt-bindings/reset/sun8i-h3-ccu.h>

/ {
	fragment@0 {
		target-path = "/";
		__overlay__ {
			reserved-memory {
				#address-cells = <1>;
				#size-cells = <1>;
				ranges;

				cma: linux,cma {
					compatible = "shared-dma-pool";
					reusable;
					size = <0x4000000>;
					alignment = <0x2000>;
					linux,cma-default;
				};
			};
		};
	};

	fragment@1 {
		target-path = "/";
		__overlay__ {
			    mali: gpu@1e80000 {
					compatible = "allwinner,sun50i-h5-mali", "arm,mali-450";
					reg = <0x01e80000 0x30000>;
					interrupts = <GIC_SPI 96 IRQ_TYPE_LEVEL_HIGH>,
							 <GIC_SPI 97 IRQ_TYPE_LEVEL_HIGH>,
							 <GIC_SPI 98 IRQ_TYPE_LEVEL_HIGH>,
							 <GIC_SPI 99 IRQ_TYPE_LEVEL_HIGH>,
							 <GIC_SPI 100 IRQ_TYPE_LEVEL_HIGH>,
							 <GIC_SPI 101 IRQ_TYPE_LEVEL_HIGH>,
							 <GIC_SPI 102 IRQ_TYPE_LEVEL_HIGH>,
							 <GIC_SPI 103 IRQ_TYPE_LEVEL_HIGH>,
							 <GIC_SPI 104 IRQ_TYPE_LEVEL_HIGH>,
							 <GIC_SPI 105 IRQ_TYPE_LEVEL_HIGH>,
							 <GIC_SPI 106 IRQ_TYPE_LEVEL_HIGH>,
							 <GIC_SPI 107 IRQ_TYPE_LEVEL_HIGH>;
					interrupt-names = "gp",
							  "gpmmu",
							  "pmu",
							  "pp",
							  "pp0",
							  "ppmmu0",
							  "pp1",
							  "ppmmu1",
							  "pp2",
							  "ppmmu2",
							  "pp3",
							  "ppmmu3";
					clocks = <&ccu CLK_BUS_GPU>, <&ccu CLK_GPU>;
					clock-names = "bus", "core";
					resets = <&ccu RST_BUS_GPU>;
					memory-region = <&cma>;

					assigned-clocks = <&ccu CLK_GPU>;
					assigned-clock-rates = <384000000>;
			};
		};
	};
};
